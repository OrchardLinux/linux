## Documentation/devicetree/bindings/clock/apple,t8010-touch-clock.yaml
```yaml
# SPDX-License-Identifier: (GPL-2.0-only OR BSD-2-Clause)
%YAML 1.2
---
$id: http://devicetree.org/schemas/clock/apple,t8010-touch-clock.yaml#
$schema: http://devicetree.org/meta-schemas/core.yaml#

title: Apple T7000/T8010 touchscreen clock controller

maintainers:
  - Paul Praschl <praschlpaul@g-p.at>

description:
  The T7000 and T8010 PMGR contain a gate and integer divider for the
  reference clock consumed by the touchscreen controller.

properties:
  compatible:
    enum:
      - apple,t7000-touch-clock
      - apple,t8010-touch-clock

  reg:
    maxItems: 1

  clocks:
    maxItems: 1

  '#clock-cells':
    const: 0

  clock-output-names:
    maxItems: 1

  clock-frequency:
    description: Target clock rate in Hz

required:
  - compatible
  - reg
  - clocks
  - '#clock-cells'
  - clock-frequency

additionalProperties: false

examples:
  - |
    clock-controller@78000 {
        compatible = "apple,t8010-touch-clock";
        reg = <0x78000 0x8>;
        #clock-cells = <0>;
        clocks = <&clkref>;
        clock-output-names = "touchclk";
        clock-frequency = <24000000>;
    };
...
```
