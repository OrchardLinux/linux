## Documentation/devicetree/bindings/usb/apple,s5l8960x-hsic-wlan.yaml
```yaml
# SPDX-License-Identifier: (GPL-2.0-only OR BSD-2-Clause)
%YAML 1.2
---
$id: http://devicetree.org/schemas/usb/apple,s5l8960x-hsic-wlan.yaml#
$schema: http://devicetree.org/meta-schemas/core.yaml#

title: Apple A7 HSIC Wi-Fi radio

maintainers:
  - Henrik Klee <henrik@goat-code.com>

description: |
  The Apple A7 (S5L8960X) iPads have a Broadcom BCM43241 Wi-Fi radio on
  an HSIC link: an EHCI root port behind its own HSIC PHY. The node
  describes that wiring, as Apple's device tree does in
  /arm-io/usb-complex/usb-ehciN/wlan, for the driver that owns the PHY,
  the radio's reset and HOST_READY, and the EHCI port. The radio's reset
  is the PMIC's GPIO3 on every board.

properties:
  compatible:
    const: apple,s5l8960x-hsic-wlan

  reg:
    items:
      - description: HSIC PHY control (+0) and configuration (+8)
      - description: EHCI controller the radio is attached to

  reg-names:
    items:
      - const: phy
      - const: ehci

  interrupts:
    maxItems: 1
    description: The EHCI controller's interrupt

  power-domains:
    maxItems: 1
    description:
      The HSIC PHY power state; its parent is the EHCI controller's.

  apple,ehci-port:
    $ref: /schemas/types.yaml#/definitions/uint32
    minimum: 1
    description: The EHCI root port of the radio

  host-ready-gpios:
    maxItems: 1
    description: HOST_READY, driven by the host

  device-ready-gpios:
    maxItems: 1
    description: DEVICE_READY, driven by the radio

required:
  - compatible
  - reg
  - reg-names
  - interrupts
  - power-domains
  - apple,ehci-port
  - host-ready-gpios
  - device-ready-gpios

additionalProperties: false

examples:
  - |
    #include <dt-bindings/gpio/gpio.h>
    #include <dt-bindings/interrupt-controller/apple-aic.h>
    #include <dt-bindings/interrupt-controller/irq.h>

    soc {
        #address-cells = <2>;
        #size-cells = <2>;

        wifi@20c000050 {
            compatible = "apple,s5l8960x-hsic-wlan";
            reg = <0x2 0x0c000050 0x0 0x10>, <0x2 0x0c200000 0x0 0x10000>;
            reg-names = "phy", "ehci";
            interrupt-parent = <&aic>;
            interrupts = <AIC_IRQ 163 IRQ_TYPE_LEVEL_HIGH>;
            power-domains = <&ps_hsic1_phy>;
            apple,ehci-port = <3>;
            host-ready-gpios = <&pinctrl 163 GPIO_ACTIVE_HIGH>;
            device-ready-gpios = <&pinctrl 164 GPIO_ACTIVE_HIGH>;
        };
    };
```

## Documentation/devicetree/bindings/usb/apple,s8000-usb-role-switch.yaml
```yaml
# SPDX-License-Identifier: (GPL-2.0-only OR BSD-2-Clause)
%YAML 1.2
---
$id: http://devicetree.org/schemas/usb/apple,s8000-usb-role-switch.yaml#
$schema: http://devicetree.org/meta-schemas/core.yaml#

title: Apple S8000 and T8010 USB role switch

maintainers:
  - Berkay Kösebay <brkosebay@users.noreply.github.com>

description: |
  The Apple A9 (S8000/S8003) and A10 (T8010) USB complex pairs a device-only
  DWC2 controller with a separate EHCI + OHCI host pair. All three share one AUSB PHY, and
  the USB_CTL register bank selects whether the PHY serves the host pair.
  The switch owns USB_CTL and the host controllers, which are its child
  nodes and exist only while the port is in the host role. Device mode is
  the default. The switch sits in the USB complex node, which owns the
  complex's DMA remap registers.

  On a Lightning port, the host role for an accessory such as the camera
  adapter also needs accessory power from the PMIC and the ACC pin routing
  of the Tristar port controller.

properties:
  compatible:
    oneOf:
      - const: apple,s8000-usb-role-switch
      - items:
          - const: apple,t8010-usb-role-switch
          - const: apple,s8000-usb-role-switch

  reg:
    items:
      - description: USB_CTL register bank

  "#address-cells":
    const: 2

  "#size-cells":
    const: 2

  ranges: true

  dma-ranges: true

  nonposted-mmio:
    $ref: /schemas/types.yaml#/definitions/flag
    description: The host controller registers need non-posted accesses.

  phys:
    maxItems: 1

  phy-names:
    const: usb2-phy

  apple,usb-device:
    $ref: /schemas/types.yaml#/definitions/phandle
    description:
      The DWC2 device controller that shares the PHY. Its gadget is
      disconnected while the port is a host.

  apple,pmic:
    $ref: /schemas/types.yaml#/definitions/phandle
    description:
      PMIC with the Lightning accessory power LDO and its switch. Without it
      the host role does not power accessories.

  apple,tristar:
    $ref: /schemas/types.yaml#/definitions/phandle
    description:
      Tristar (CBTL1610) Lightning port controller whose ACC pin routing is
      set up before accessory power is turned on. Required for accessory
      power.

patternProperties:
  "^usb@[0-9a-f]+$":
    type: object
    description: The EHCI and its OHCI companion.

required:
  - compatible
  - reg
  - "#address-cells"
  - "#size-cells"
  - ranges
  - phys
  - phy-names
  - apple,usb-device

dependentRequired:
  apple,pmic: [ "apple,tristar" ]

additionalProperties: false

examples:
  - |
    #include <dt-bindings/interrupt-controller/apple-aic.h>
    #include <dt-bindings/interrupt-controller/irq.h>
    #include <dt-bindings/phy/phy.h>

    bus {
        #address-cells = <2>;
        #size-cells = <2>;

        usb-role-switch@20e0d8000 {
            compatible = "apple,s8000-usb-role-switch";
            reg = <0x2 0x0e0d8000 0x0 0x1000>;
            #address-cells = <2>;
            #size-cells = <2>;
            ranges;
            dma-ranges;
            nonposted-mmio;
            phys = <&ausbphy0 PHY_TYPE_USB2>;
            phy-names = "usb2-phy";
            apple,usb-device = <&usbdev>;
            apple,pmic = <&pmic>;
            apple,tristar = <&tristar>;

            usb@20c200000 {
                compatible = "apple,s8000-ehci", "generic-ehci";
                reg = <0x2 0x0c200000 0x0 0x10000>;
                interrupts = <AIC_IRQ 215 IRQ_TYPE_LEVEL_HIGH>;
            };

            usb@20c300000 {
                compatible = "apple,s8000-ohci", "generic-ohci";
                reg = <0x2 0x0c300000 0x0 0x10000>;
                interrupts = <AIC_IRQ 216 IRQ_TYPE_LEVEL_HIGH>;
            };
        };
    };
```

## Documentation/devicetree/bindings/w1/apple,j120-hdq-uart.yaml
```yaml
# SPDX-License-Identifier: (GPL-2.0-only OR BSD-2-Clause)
%YAML 1.2
---
$id: http://devicetree.org/schemas/w1/apple,j120-hdq-uart.yaml#
$schema: http://devicetree.org/meta-schemas/core.yaml#

title: Apple J120 UART HDQ battery bus

maintainers:
  - tompta1 <546706+tompta1@users.noreply.github.com>

description: |
  The J120 battery gauge uses an HDQ bus driven by UART symbols. The
  board-specific compatible selects bounded, read-only telemetry transactions.

properties:
  compatible:
    items:
      - const: apple,j120-hdq-uart
      - const: ti,hdq-uart

  fuel-gauge:
    $ref: /schemas/power/supply/apple,j120-bq27540.yaml#

required:
  - compatible
  - fuel-gauge

additionalProperties: false
```

## drivers/usb/roles/Kconfig
```kconfig
# SPDX-License-Identifier: GPL-2.0

config USB_ROLE_SWITCH
	tristate "USB Role Switch Support"
	help
	  USB Role Switch is a device that can select the USB role - host or
	  device - for a USB port (connector). In most cases dual-role capable
	  USB controller will also represent the switch, but on some platforms
	  multiplexer/demultiplexer switch is used to route the data lines on
	  the USB connector between separate USB host and device controllers.

	  Say Y here if your USB connectors support both device and host roles.
	  To compile the driver as module, choose M here: the module will be
	  called roles.ko.

if USB_ROLE_SWITCH

config USB_ROLES_INTEL_XHCI
	tristate "Intel XHCI USB Role Switch"
	depends on ACPI && X86
	help
	  Driver for the internal USB role switch for switching the USB data
	  lines between the xHCI host controller and the dwc3 gadget controller
	  found on various Intel SoCs.

	  To compile the driver as a module, choose M here: the module will
	  be called intel-xhci-usb-role-switch.

config USB_ROLES_APPLE_S8000
	tristate "Apple A9 and A10 Lightning port role switch"
	depends on ARCH_APPLE || COMPILE_TEST
	depends on OF && I2C && USB_GADGET
	select REGMAP
	help
	  Role switch for the Apple A9 and A10 USB complex, which pairs a
	  device-only DWC2 with a separate EHCI + OHCI host pair behind one
	  PHY. Device mode is the default; the Lightning accessory policy of
	  the Tristar charger enters host mode while the camera adapter is
	  attached.

	  To compile the driver as a module, choose M here: the module will
	  be called apple-s8000-usb-role.

endif # USB_ROLE_SWITCH
```
