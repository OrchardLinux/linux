## Documentation/devicetree/bindings/clock/apple,s5l8960x-touch-clock.yaml
```yaml
# SPDX-License-Identifier: GPL-2.0-only OR BSD-2-Clause
%YAML 1.2
---
$id: http://devicetree.org/schemas/clock/apple,s5l8960x-touch-clock.yaml#
$schema: http://devicetree.org/meta-schemas/core.yaml#

title: Apple S5L8960X touchscreen reference clock

maintainers:
  - thisiscamk <100883750+thisiscamk@users.noreply.github.com>

description:
  PWM0 channel 2 generates the touchscreen reference clock. Its count and
  control register layout differs from the later Apple FPWM block. The
  clock is nominally 32768 Hz, rounded to an even number of reference-clock
  cycles for a symmetric waveform. Other PWM channels are not described.

properties:
  compatible:
    const: apple,s5l8960x-touch-clock

  reg:
    maxItems: 1

  clocks:
    maxItems: 1

  power-domains:
    maxItems: 1

  '#clock-cells':
    const: 0

  clock-frequency:
    const: 32768

required:
  - compatible
  - reg
  - clocks
  - power-domains
  - '#clock-cells'
  - clock-frequency

additionalProperties: false

examples:
  - |
    clock-controller@a118000 {
        compatible = "apple,s5l8960x-touch-clock";
        reg = <0x0a118000 0x4000>;
        clocks = <&clkref>;
        power-domains = <&ps_pwm0>;
        #clock-cells = <0>;
        clock-frequency = <32768>;
    };
```

## Documentation/devicetree/bindings/display/apple,t8011-h9g-display.yaml
```yaml
# SPDX-License-Identifier: (GPL-2.0-only OR BSD-2-Clause)
%YAML 1.2
---
$id: http://devicetree.org/schemas/display/apple,t8011-h9g-display.yaml#
$schema: http://devicetree.org/meta-schemas/core.yaml#

title: Apple A10X H9G display controller

maintainers:
  - tom <tompt@seznam.cz>

description: |
  The H9G display controller scans out to the internal panel. The bootloader
  may leave the controller, link and panel running with a simple framebuffer.
  The simple-framebuffer node's display phandle identifies the controller.

properties:
  compatible:
    const: apple,t8011-h9g-display

  reg:
    maxItems: 1

required:
  - compatible
  - reg

additionalProperties: false
```

## Documentation/devicetree/bindings/dma/apple,sio.yaml
```yaml
# SPDX-License-Identifier: (GPL-2.0-only OR BSD-2-Clause)
%YAML 1.2
---
$id: http://devicetree.org/schemas/dma/apple,sio.yaml#
$schema: http://devicetree.org/meta-schemas/core.yaml#

title: Apple T7000/S8000/T8010 SmartIO coprocessor and DMA controller

description: |
  The T7000 (A8, A8X), S8000 (A9) and T8010 (A10) SmartIO coprocessor
  provides DMA channels
  for peripheral controllers. The application processor boots the SmartIO
  firmware and submits DMA commands through the SIO message queues. Clients
  select the firmware endpoint number used by their peripheral.

maintainers:
  - Paul Praschl <praschlpaul@g-p.at>

allOf:
  - $ref: dma-controller.yaml#

properties:
  compatible:
    enum:
      - apple,t7000-sio
      - apple,s8000-sio
      - apple,t8010-sio

  reg:
    minItems: 1
    items:
      - description: AppleA7IOP coprocessor and message queue registers
      - description: SmartIO DMA shim registers

  reg-names:
    minItems: 1
    items:
      - const: a7iop
      - const: shim

  interrupts:
    minItems: 4
    maxItems: 4
    description:
      The four interrupt outputs of the SIO node in the Apple device tree, in
      the same order.

  power-domains:
    maxItems: 1

  resets:
    maxItems: 1
    description:
      Power-state reset, used if the coprocessor is found already running.

  firmware-name:
    maxItems: 1

  dma-channels:
    const: 64

  '#dma-cells':
    const: 1
    description:
      Clients specify the SmartIO DMA endpoint number, for example 0x1a for
      SPI3 transmit, 0x1b for SPI3 receive or 0x28 for MCA0 transmit.

if:
  properties:
    compatible:
      contains:
        enum:
          - apple,s8000-sio
          - apple,t8010-sio
then:
  properties:
    reg:
      minItems: 2
    reg-names:
      minItems: 2
else:
  description:
    The T7000's AppleA7IOP version 1 block is a single 0x2000 window, and
    Apple's device tree describes no shim registers for it.
  properties:
    reg:
      maxItems: 1
    reg-names:
      maxItems: 1

required:
  - compatible
  - reg
  - reg-names
  - interrupts
  - power-domains
  - firmware-name
  - dma-channels
  - '#dma-cells'

additionalProperties: false

examples:
  - |
    #include <dt-bindings/interrupt-controller/apple-aic.h>
    #include <dt-bindings/interrupt-controller/irq.h>

    soc {
      #address-cells = <2>;
      #size-cells = <2>;

      sio: dma-controller@20ae00000 {
        compatible = "apple,t8010-sio";
        reg = <0x2 0x0ae00000 0x0 0x10000>,
              <0x2 0x0a000000 0x0 0x2000>;
        reg-names = "a7iop", "shim";
        interrupts = <AIC_IRQ 211 IRQ_TYPE_LEVEL_HIGH>,
                     <AIC_IRQ 210 IRQ_TYPE_LEVEL_HIGH>,
                     <AIC_IRQ 213 IRQ_TYPE_LEVEL_HIGH>,
                     <AIC_IRQ 212 IRQ_TYPE_LEVEL_HIGH>;
        power-domains = <&ps_sio>;
        firmware-name = "apple/t8010-smartio.bin";
        dma-channels = <64>;
        #dma-cells = <1>;
      };
    };
```

## Documentation/devicetree/bindings/gpu/apple,s8003-gpu.yaml
```yaml
# SPDX-License-Identifier: (GPL-2.0-only OR BSD-2-Clause)
%YAML 1.2
---
$id: http://devicetree.org/schemas/gpu/apple,s8003-gpu.yaml#
$schema: http://devicetree.org/meta-schemas/core.yaml#

title: Apple S8000/S8003 (A9) and T7000 (A8) GPU

maintainers:
  - Berkay Kösebay <brkosebay@users.noreply.github.com>

description: |
  The A9's GPU is a PowerVR Rogue core (GT7600, Apple's G5P) behind Apple's
  "Fender" power and control block. Apple's firmware runs on the core's own
  META processor; the host loads it. The node has the shape of the A10's
  (apple,t8010-gpu), without that chip's coprocessor and mailbox.

  The A8's GPU (GX6450, Apple's G4P) runs the same family of firmware the
  same way. Its driver powers the GPU itself, in the order Apple's kernel
  does: the power manager's GPU power state, its PLL and two of its global
  enables, and the two bus bridges in front of the GPU, so the node names
  those registers instead of a power domain.

properties:
  compatible:
    oneOf:
      - enum:
          - apple,s8003-gpu
          - apple,t7000-gpu
      - items:
          - const: apple,s8000-gpu
          - const: apple,s8003-gpu

  reg:
    minItems: 2
    items:
      - description: The Rogue core's registers
      - description: Fender
      - description: The power manager's registers (A8)
      - description: The GPU's two bus bridges (A8)

  reg-names:
    minItems: 2
    items:
      - const: rgx
      - const: fender
      - const: pmgr
      - const: bridges

  interrupts:
    items:
      - description: GPU interrupt 0
      - description: GPU interrupt 1
      - description: GPU interrupt 2
      - description: GPU interrupt 3
      - description:
          The firmware's interrupt to the host, a software interrupt of the
          interrupt controller. The firmware raises it through that
          controller's registers, so the host tells it their address and
          the interrupt's number.

  power-domains:
    maxItems: 1

  operating-points-v2: true

  firmware-name:
    maxItems: 1
    description:
      The firmware file, Apple's META LDR image from the device's own
      kernelcache.

required:
  - compatible
  - reg
  - reg-names
  - interrupts

allOf:
  - if:
      properties:
        compatible:
          const: apple,t7000-gpu
    then:
      properties:
        reg:
          minItems: 4
        reg-names:
          minItems: 4
        power-domains: false
    else:
      properties:
        reg:
          maxItems: 2
        reg-names:
          maxItems: 2
      required:
        - power-domains

additionalProperties: false

examples:
  - |
    #include <dt-bindings/interrupt-controller/apple-aic.h>
    #include <dt-bindings/interrupt-controller/irq.h>

    soc {
        #address-cells = <2>;
        #size-cells = <2>;

        gpu@201000000 {
            compatible = "apple,s8003-gpu";
            reg = <0x2 0x01000000 0x0 0x100000>,
                  <0x2 0x01e00000 0x0 0x100000>;
            reg-names = "rgx", "fender";
            power-domains = <&ps_gfx>;
            interrupt-parent = <&aic>;
            interrupts = <AIC_IRQ 170 IRQ_TYPE_LEVEL_HIGH>,
                         <AIC_IRQ 171 IRQ_TYPE_LEVEL_HIGH>,
                         <AIC_IRQ 172 IRQ_TYPE_LEVEL_HIGH>,
                         <AIC_IRQ 173 IRQ_TYPE_LEVEL_HIGH>,
                         <AIC_IRQ 174 IRQ_TYPE_LEVEL_HIGH>;
            firmware-name = "apple/gfx-s8003.bin";
        };
    };

  - |
    #include <dt-bindings/interrupt-controller/apple-aic.h>
    #include <dt-bindings/interrupt-controller/irq.h>

    soc {
        #address-cells = <2>;
        #size-cells = <2>;

        gpu@201000000 {
            compatible = "apple,t7000-gpu";
            reg = <0x2 0x01000000 0x0 0x100000>,
                  <0x2 0x01e00000 0x0 0x100000>,
                  <0x2 0x0e000000 0x0 0x40000>,
                  <0x2 0x01f00000 0x0 0x81000>;
            reg-names = "rgx", "fender", "pmgr", "bridges";
            interrupt-parent = <&aic>;
            interrupts = <AIC_IRQ 134 IRQ_TYPE_LEVEL_HIGH>,
                         <AIC_IRQ 135 IRQ_TYPE_LEVEL_HIGH>,
                         <AIC_IRQ 136 IRQ_TYPE_LEVEL_HIGH>,
                         <AIC_IRQ 137 IRQ_TYPE_LEVEL_HIGH>,
                         <AIC_IRQ 138 IRQ_TYPE_LEVEL_HIGH>;
            firmware-name = "apple/gfx-t7000.bin";
        };
    };
```

## Documentation/devicetree/bindings/hwmon/apple,soc-temp.yaml
```yaml
# SPDX-License-Identifier: (GPL-2.0-only OR BSD-2-Clause)
%YAML 1.2
---
$id: http://devicetree.org/schemas/hwmon/apple,soc-temp.yaml#
$schema: http://devicetree.org/meta-schemas/core.yaml#

title: Apple SoC die temperature sensors

maintainers:
  - Henrik Klee <henrik@goat-code.com>

description: |
  The die temperature sensors of the Apple A12 (T8020), called
  "tempsensor,t8020" in the Apple device tree. They sit in three register
  blocks, one node each: five sensors in the power manager, three in the
  performance cluster (the cluster and its two cores) and one in the
  efficiency cluster.

  The sensor specifier is the sensor's index within its block.

allOf:
  - $ref: /schemas/thermal/thermal-sensor.yaml#

properties:
  compatible:
    enum:
      - apple,t8020-pmgr-tempsensor
      - apple,t8020-acc-tempsensor
      - apple,t8020-acce-tempsensor

  reg:
    maxItems: 1

  '#thermal-sensor-cells':
    const: 1

required:
  - compatible
  - reg

unevaluatedProperties: false

examples:
  - |
    soc {
        #address-cells = <2>;
        #size-cells = <2>;

        tempsensor@211e30000 {
            compatible = "apple,t8020-acc-tempsensor";
            reg = <0x2 0x11e30000 0x0 0x8000>;
            #thermal-sensor-cells = <1>;
        };
    };
```

## Documentation/devicetree/bindings/iio/adc/apple,d2186-adc.yaml
```yaml
# SPDX-License-Identifier: (GPL-2.0-only OR BSD-2-Clause)
%YAML 1.2
---
$id: http://devicetree.org/schemas/iio/adc/apple,d2186-adc.yaml#
$schema: http://devicetree.org/meta-schemas/core.yaml#

title: Apple D2186 PMIC housekeeping ADC

maintainers:
  - Berkay Kösebay <brkosebay@users.noreply.github.com>

description: |
  The Dialog D2186 PMIC used on Apple A8 devices includes a 12-bit
  housekeeping ADC accessed through the parent Apple I2C PMIC regmap.
  It exposes battery, USB and system telemetry channels indexed by their
  hardware multiplexer channel number:
    0  - vcc_main (system supply voltage)
    1  - ich (charger output current)
    2  - tbat (battery NTC thermistor temperature)
    4  - vbat (battery voltage)
    9  - ibus (USB input current)
    15 - vbus (USB bus voltage)

properties:
  compatible:
    const: apple,d2186-adc

  reg:
    maxItems: 1
    description: ADC control and result register range inside the PMIC regmap.

  "#io-channel-cells":
    const: 1

required:
  - compatible
  - reg
  - "#io-channel-cells"

additionalProperties: false

examples:
  - |
    i2c {
        #address-cells = <1>;
        #size-cells = <0>;

        pmic@74 {
            compatible = "apple,adi-pmic", "apple,i2c-pmic";
            reg = <0x74>;
            #address-cells = <1>;
            #size-cells = <1>;

            adc@500 {
                compatible = "apple,d2186-adc";
                reg = <0x500 0x24>;
                #io-channel-cells = <1>;
            };
        };
    };
```

## Documentation/devicetree/bindings/iio/adc/apple,orion-bellatrix-vbus.yaml
```yaml
# SPDX-License-Identifier: (GPL-2.0-only OR BSD-2-Clause)
%YAML 1.2
---
$id: http://devicetree.org/schemas/iio/adc/apple,orion-bellatrix-vbus.yaml#
$schema: http://devicetree.org/meta-schemas/core.yaml#

title: Apple Orion Bellatrix Lightning VBUS ADC

maintainers:
  - tom <tompt@seznam.cz>

description:
  Orion Bellatrix provides an ADC input wired to Lightning VBUS on J120.

properties:
  compatible:
    const: apple,orion-bellatrix-vbus

  reg:
    maxItems: 1

required:
  - compatible
  - reg

additionalProperties: false
```

## Documentation/devicetree/bindings/iio/imu/apple,s5l8960x-oscar.yaml
```yaml
# SPDX-License-Identifier: (GPL-2.0-only OR BSD-2-Clause)
%YAML 1.2
---
$id: http://devicetree.org/schemas/iio/imu/apple,s5l8960x-oscar.yaml#
$schema: http://devicetree.org/meta-schemas/core.yaml#

title: Apple M7 motion coprocessor

maintainers:
  - ricktav <82380971+ricktav@users.noreply.github.com>

description:
  The M7 ("Oscar") of the Apple A7 iPads, a microcontroller on a UART that
  carries the accelerometer, gyroscope and compass. It has no firmware of its
  own; the host uploads it at every power-up.

allOf:
  - $ref: /schemas/serial/serial-peripheral-props.yaml#

properties:
  compatible:
    const: apple,s5l8960x-oscar

  core-supply:
    description: M7 core supply (Apple's oscar_power1).

  io-supply:
    description: M7 I/O supply (Apple's oscar_power2).

  sensors-supply:
    description: Sensor supply (Apple's sensor_power).

  reset-gpios:
    maxItems: 1

  firmware-name:
    maxItems: 1

  mount-matrix:
    description: Orientation of the accelerometer in the device.

required:
  - compatible
  - core-supply
  - io-supply
  - sensors-supply
  - reset-gpios

unevaluatedProperties: false

examples:
  - |
    #include <dt-bindings/gpio/gpio.h>
    serial {
        motion-coprocessor {
            compatible = "apple,s5l8960x-oscar";
            core-supply = <&oscar_core>;
            io-supply = <&oscar_io>;
            sensors-supply = <&oscar_sensors>;
            reset-gpios = <&pinctrl 66 GPIO_ACTIVE_LOW>;
            mount-matrix = "1", "0", "0",
                           "0", "-1", "0",
                           "0", "0", "1";
        };
    };

...
```
