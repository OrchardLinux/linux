## Documentation/devicetree/bindings/iio/light/apple,ct709.yaml
```yaml
# SPDX-License-Identifier: GPL-2.0-only OR BSD-2-Clause
%YAML 1.2
---
$id: http://devicetree.org/schemas/iio/light/apple,ct709.yaml#
$schema: http://devicetree.org/meta-schemas/core.yaml#

title: Apple CT709 four-channel ambient light sensor

maintainers:
  - Linux IIO <linux-iio@vger.kernel.org>

description:
  The CT709 measures clear, red, green and blue light intensity over I2C.
  The iPad Pro 2 boards have two independently addressed sensors.

properties:
  compatible:
    const: apple,ct709

  reg:
    maxItems: 1

  apple,als-calibration:
    $ref: /schemas/types.yaml#/definitions/uint8-array
    minItems: 6696
    maxItems: 9992
    description:
      Factory calibration supplied by the bootloader from the resolved Apple
      device tree alsCalibration property. On J120 the eight-byte header and
      two 3344-byte orientation records can be followed by padding. The
      property on the als0 node contains records for both sensors.

  apple,als-orientation:
    $ref: /schemas/types.yaml#/definitions/uint32
    description:
      The orientation index of this sensor's record in the factory
      calibration (byte 2 of each record). Without it the sensor reports
      raw channels only.

required:
  - compatible
  - reg

additionalProperties: false
```

## Documentation/devicetree/bindings/input/touchscreen/apple,d221-touchscreen.yaml
```yaml
# SPDX-License-Identifier: (GPL-2.0-only OR BSD-2-Clause)
%YAML 1.2
---
$id: http://devicetree.org/schemas/input/touchscreen/apple,d221-touchscreen.yaml#
$schema: http://devicetree.org/meta-schemas/core.yaml#

title: Apple iPhone X and iPhone XR HIDSPI touchscreens

maintainers:
  - Eduardo Martins <eduardo@martins.ws>

description:
  The touch controllers of the iPhone X (ADT "hid-transport,k1") and the
  iPhone XR (ADT "hid-transport,spi") on an SPI bus. They start in an HBPP
  bootloader that loads the firmware from the host, then report touches over
  Apple's HIDSPI transport. The per-unit calibrations come from the ADT's
  multi-touch node; the bootloader copies them through the touchscreen0
  alias.

allOf:
  - $ref: touchscreen.yaml#
  - $ref: /schemas/spi/spi-peripheral-props.yaml#
  - if:
      properties:
        compatible:
          const: apple,d221-touchscreen
    then:
      properties:
        hv-supply: false
        core-supply: false
        clken-supply: false
      required:
        - interrupts
        - ana-supply
        - clocks
    else:
      properties:
        ana-supply: false
        clocks: false
      required:
        - hv-supply
        - core-supply
        - clken-supply

properties:
  compatible:
    enum:
      - apple,d221-touchscreen
      - apple,n841-touchscreen

  reg:
    maxItems: 1

  interrupts:
    maxItems: 1
    description:
      The controller's interrupt line, low while a packet waits on the
      iPhone X. Not used on the iPhone XR: its line (AOP pin 19) was measured
      not to move for the firmware's boot message, replies or touch reports,
      so the driver reads on a timer there.

  reset-gpios:
    maxItems: 1

  ana-supply:
    description: Analog supply of the touch controller.

  hv-supply:
    description:
      Analog supply of the touch controller from the display PMU, the ADT's
      function-power_ana.

  core-supply:
    description:
      Core supply of the touch controller, the ADT's function-power_ldo.

  clken-supply:
    description:
      Switch of the touch controller's clock, the ADT's
      function-clock_enable, where the SMC provides it.

  clocks:
    maxItems: 1

  firmware-name:
    maxItems: 1
    description:
      Start of the controller firmware's file name; the driver appends
      -<apple,hid-merge-personality>.bin. The firmware is converted from
      Apple's multitouch firmware.

  apple,hid-merge-personality:
    $ref: /schemas/types.yaml#/definitions/string
    description:
      The ADT's hid-merge-personality, the firmware variant this unit needs.

  apple,z2-cal-blob:
    $ref: /schemas/types.yaml#/definitions/uint8-array
    description: The ADT's multi-touch-calibration.

patternProperties:
  "^apple,luna-[a-z-]+$":
    $ref: /schemas/types.yaml#/definitions/uint8-array
    description: The ADT's 3D Touch calibrations, under their ADT names.

required:
  - compatible
  - reg
  - reset-gpios
  - firmware-name
  - apple,hid-merge-personality

unevaluatedProperties: false

examples:
  - |
    #include <dt-bindings/gpio/gpio.h>
    #include <dt-bindings/interrupt-controller/irq.h>

    spi {
        #address-cells = <1>;
        #size-cells = <0>;

        touchscreen@0 {
            compatible = "apple,d221-touchscreen";
            reg = <0>;
            spi-max-frequency = <4000000>;
            interrupts-extended = <&pinctrl_aop 21 IRQ_TYPE_LEVEL_LOW>;
            reset-gpios = <&pinctrl_ap 33 GPIO_ACTIVE_LOW>;
            ana-supply = <&touch_ana>;
            clocks = <&touchclk>;
            firmware-name = "apple/d221-touch";
            apple,hid-merge-personality = "C1R1FC0,2";
            touchscreen-size-x = <1125>;
            touchscreen-size-y = <2436>;
        };
    };

...
```

## Documentation/devicetree/bindings/mtd/apple,h2fmi.yaml
```yaml
# SPDX-License-Identifier: (GPL-2.0-only OR BSD-2-Clause)
%YAML 1.2
---
$id: http://devicetree.org/schemas/mtd/apple,h2fmi.yaml#
$schema: http://devicetree.org/meta-schemas/core.yaml#

title: Apple S5L H2FMI flash controller

maintainers:
  - Shayne Legault <8741557+shaynelegault@users.noreply.github.com>

description:
  The H2FMI controller drives the Hynix PPN packages used as boot storage on
  Apple S5L8940X-family devices. Each of its two buses has separate FMI, FMC
  and ECC register windows.

properties:
  compatible:
    const: apple,s5l8940x-fmi

  reg:
    minItems: 6
    maxItems: 6

  interrupts:
    minItems: 2
    maxItems: 2

required:
  - compatible
  - reg
  - interrupts

additionalProperties: false

examples:
  - |
    flash-controller@1200000 {
        compatible = "apple,s5l8940x-fmi";
        reg = <0x1200000 0x1000>,
              <0x1240000 0x1000>,
              <0x1280000 0x1000>,
              <0x1300000 0x1000>,
              <0x1340000 0x1000>,
              <0x1380000 0x1000>;
        interrupts = <33>, <34>;
    };
```

## Documentation/devicetree/bindings/power/supply/apple,d2186-battery.yaml
```yaml
# SPDX-License-Identifier: (GPL-2.0-only OR BSD-2-Clause)
%YAML 1.2
---
$id: http://devicetree.org/schemas/power/supply/apple,d2186-battery.yaml#
$schema: http://devicetree.org/meta-schemas/core.yaml#

title: Apple D2186 PMIC battery and charger monitor

maintainers:
  - Berkay Kösebay <brkosebay@users.noreply.github.com>

description: |
  Devices such as the Apple iPod touch 6 (N102) have no dedicated fuel-gauge
  IC. Battery telemetry is sampled through the Dialog D2186 PMIC housekeeping
  ADC and charging state is read from the PMIC status registers (0x60..0x6d)
  through the parent Apple I2C PMIC regmap.

allOf:
  - $ref: power-supply.yaml#

properties:
  compatible:
    const: apple,d2186-battery

  io-channels:
    minItems: 1
    maxItems: 5

  io-channel-names:
    minItems: 1
    maxItems: 5
    items:
      enum:
        - vbat
        - ich
        - tbat
        - vbus
        - ibus

  monitored-battery: true

required:
  - compatible
  - io-channels
  - io-channel-names

additionalProperties: false

examples:
  - |
    bat: battery {
        compatible = "simple-battery";
        device-chemistry = "lithium-ion";
        charge-full-design-microamp-hours = <1080000>;
        voltage-min-design-microvolt = <3400000>;
        voltage-max-design-microvolt = <4350000>;
        ocv-capacity-celsius = <20>;
        ocv-capacity-table-0 = <4350000 100>, <3840000 50>, <3400000 0>;
    };

    i2c {
        #address-cells = <1>;
        #size-cells = <0>;

        pmic@74 {
            compatible = "apple,adi-pmic", "apple,i2c-pmic";
            reg = <0x74>;
            #address-cells = <1>;
            #size-cells = <1>;

            pmu_adc: adc@500 {
                compatible = "apple,d2186-adc";
                reg = <0x500 0x24>;
                #io-channel-cells = <1>;
            };

            battery {
                compatible = "apple,d2186-battery";
                monitored-battery = <&bat>;
                io-channels = <&pmu_adc 4>,
                              <&pmu_adc 1>,
                              <&pmu_adc 2>,
                              <&pmu_adc 15>,
                              <&pmu_adc 9>;
                io-channel-names = "vbat", "ich", "tbat", "vbus", "ibus";
            };
        };
    };
```

## Documentation/devicetree/bindings/power/supply/apple,d2355-tristar-charger.yaml
```yaml
# SPDX-License-Identifier: (GPL-2.0-only OR BSD-2-Clause)
%YAML 1.2
---
$id: http://devicetree.org/schemas/power/supply/apple,d2355-tristar-charger.yaml#
$schema: http://devicetree.org/meta-schemas/core.yaml#

title: Apple D2355 Tristar Lightning charger

maintainers:
  - Henrik Klee <henrik@goat-code.com>

description: |
  The D2355 sets the Lightning input current on the iPad Pro 12.9-inch (2017).
  A Tristar port controller identifies the attached source using the ADC in the
  August PMIC. The charger controls the role of the USB device controller while
  identifying the source.

allOf:
  - $ref: power-supply.yaml#

properties:
  io-channels:
    maxItems: 1

  io-channel-names:
    const: vbus

  compatible:
    const: apple,d2355-tristar-charger

  reg:
    items:
      - description: Charger status register bank.
      - description: Charger control register bank.
      - description: ADC register bank in the August PMIC.

  reg-names:
    items:
      - const: status
      - const: control
      - const: adc

  interrupts-extended:
    items:
      - description: D2355 parent-line notification.
      - description: August ADC conversion complete.
      - description: D2355 source event 40.
      - description: D2355 source event 42.
      - description: D2355 source event 53.

  apple,tristar:
    $ref: /schemas/types.yaml#/definitions/phandle
    description: The Tristar port controller.

  apple,adc-pmic:
    $ref: /schemas/types.yaml#/definitions/phandle
    description: The August PMIC providing the ADC registers.

  firmware-name:
    maxItems: 1
    description: The D2355 input-limit calibration for this unit.

  apple,pack-limits:
    $ref: /schemas/types.yaml#/definitions/int32-array
    description: |
      Minimum and maximum battery temperature in tenths of a degree Celsius,
      voltage in microvolts, and signed current in microamps, in that order.
    items:
      - description: Minimum temperature.
      - description: Maximum temperature.
      - description: Minimum voltage.
      - description: Maximum voltage.
      - description: Minimum current.
      - description: Maximum current.

  input-current-limit-microamp:
    description: Board maximum input current.

  port:
    $ref: /schemas/graph.yaml#/properties/port
    description: Link to the USB controller whose role the charger sets.

required:
  - compatible
  - reg
  - reg-names
  - interrupts-extended
  - apple,tristar
  - apple,adc-pmic
  - firmware-name
  - apple,pack-limits
  - input-current-limit-microamp
  - port

unevaluatedProperties: false
```

## Documentation/devicetree/bindings/power/supply/apple,j120-bq27540.yaml
```yaml
# SPDX-License-Identifier: (GPL-2.0-only OR BSD-2-Clause)
%YAML 1.2
---
$id: http://devicetree.org/schemas/power/supply/apple,j120-bq27540.yaml#
$schema: http://devicetree.org/meta-schemas/core.yaml#

title: Apple J120 BQ27540 HDQ fuel gauge

maintainers:
  - tompta1 <546706+tompta1@users.noreply.github.com>

description: |
  The J120 battery gauge uses HDQ and the BQ27541 register layout. Its
  telemetry profile uses RemainingCapacity rather than NominalAvailableCapacity.
  It is a child of an HDQ bus, not an I2C device.

properties:
  compatible:
    items:
      - const: apple,j120-bq27540
      - const: ti,bq27540-hdq

  monitored-battery:
    $ref: /schemas/types.yaml#/definitions/phandle
    description: Battery characteristics, if independently known.

required:
  - compatible

additionalProperties: false

examples:
  - |
    hdq {
        fuel-gauge {
            compatible = "apple,j120-bq27540", "ti,bq27540-hdq";
        };
    };
```

## Documentation/devicetree/bindings/regulator/apple,smc-regulator.yaml
```yaml
# SPDX-License-Identifier: (GPL-2.0-only OR BSD-2-Clause)
%YAML 1.2
---
$id: http://devicetree.org/schemas/regulator/apple,smc-regulator.yaml#
$schema: http://devicetree.org/meta-schemas/core.yaml#

title: Apple SMC power switches

maintainers:
  - Dugs <dugahol@protonmail.com>

description:
  On the A11 and A12 iPhones the SMC switches some peripheral supplies on
  and off. Which supplies exist depends on the SMC firmware, so the
  compatible selects them; each one is described by a child node named
  after it.

properties:
  compatible:
    enum:
      - apple,t8015-smc-regulator
      - apple,t8020-smc-regulator

patternProperties:
  "^mesa-(1v8|3v0)$":
    type: object
    $ref: regulator.yaml#
    unevaluatedProperties: false
    description: Touch ID sensor 1.8 V and 3 V supplies

  "^touch-(core|clock)$":
    type: object
    $ref: regulator.yaml#
    unevaluatedProperties: false
    description:
      Touch controller core supply, and the switch of the touch
      controller's clock

required:
  - compatible

allOf:
  - if:
      properties:
        compatible:
          const: apple,t8015-smc-regulator
    then:
      patternProperties:
        "^touch-(core|clock)$": false
    else:
      patternProperties:
        "^mesa-(1v8|3v0)$": false

additionalProperties: false

examples:
  - |
    regulators {
      compatible = "apple,t8015-smc-regulator";

      mesa-1v8 {
        regulator-name = "mesa-1v8";
      };

      mesa-3v0 {
        regulator-name = "mesa-3v0";
      };
    };
```

## Documentation/devicetree/bindings/soc/apple/apple,mesa.yaml
```yaml
# SPDX-License-Identifier: (GPL-2.0-only OR BSD-2-Clause)
%YAML 1.2
---
$id: http://devicetree.org/schemas/soc/apple/apple,mesa.yaml#
$schema: http://devicetree.org/meta-schemas/core.yaml#

title: Apple Mesa (Touch ID) sensor

maintainers:
  - Dugs <dugahol@protonmail.com>

description:
  The Touch ID sensor of the A11 iPhones, on its own SPI bus in SPI mode 2,
  with a 1.8 V and a 3 V supply.

allOf:
  - $ref: /schemas/spi/spi-peripheral-props.yaml#

properties:
  compatible:
    const: apple,mesa

  reg:
    maxItems: 1

  vdd18-supply:
    description: 1.8 V supply, switched on first

  vdd30-supply:
    description: 3 V supply

required:
  - compatible
  - reg
  - vdd18-supply
  - vdd30-supply

unevaluatedProperties: false

examples:
  - |
    spi {
      #address-cells = <1>;
      #size-cells = <0>;

      touch-id@0 {
        compatible = "apple,mesa";
        reg = <0>;
        spi-max-frequency = <4000000>;
        spi-cpol;
        vdd18-supply = <&mesa_1v8>;
        vdd30-supply = <&mesa_3v0>;
      };
    };
```
