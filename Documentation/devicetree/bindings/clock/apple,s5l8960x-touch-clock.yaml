## Documentation/devicetree/bindings/sound/apple,s8000-mca.yaml
```yaml
# SPDX-License-Identifier: (GPL-2.0-only OR BSD-2-Clause)
%YAML 1.2
---
$id: http://devicetree.org/schemas/sound/apple,s8000-mca.yaml#
$schema: http://devicetree.org/meta-schemas/core.yaml#

title: Apple S5L8960X/T7001/S8000/T8010 MCA I2S controller

maintainers:
  - Berkay Kösebay <brkosebay@users.noreply.github.com>

description: |
  The "mca-version 4" serializer of the Apple A9. Each MCA has a register
  window and a 32-bit MCLK control word, which the driver exports as the
  clock feeding the codec's MCLK. Its pads are connected to the outside
  through the i2s-switch, a routing block shared by all MCAs. Samples are
  moved by SmartIO DMA. T8010 uses the same register layout (version 5),
  with an AP NCO bitclock: apple,t8010-mca is the playback-only digital
  speaker link (TDM), apple,t8010-mca-i2s the playback-only stereo I2S link
  to the headphone codec. The MCAs are the same block; the compatible names
  the link setup iOS programs into it. The T7001 (A8X) MCA is the older
  "mca-version 1" register layout with the same fields: apple,t7001-mca is
  the playback-only speaker link (TDM) of the iPad Air 2, clocked from an AP
  NCO channel running at twice the bit clock. The S5L8960X (A7) MCA is
  version 1 as well: apple,s5l8960x-mca is the playback-only I2S link of the
  iPad Air to its codec, which provides the bit and frame clocks as on the
  A9.

allOf:
  - $ref: dai-common.yaml#
  - if:
      properties:
        compatible:
          enum:
            - apple,t7001-mca
            - apple,t8010-mca
            - apple,t8010-mca-i2s
    then:
      properties:
        dmas:
          maxItems: 1
        dma-names:
          maxItems: 1
      required:
        - clocks
        - clock-names
    else:
      properties:
        clocks: false
        clock-names: false

properties:
  compatible:
    enum:
      - apple,s5l8960x-mca
      - apple,s8000-mca
      - apple,t7001-mca
      - apple,t8010-mca
      - apple,t8010-mca-i2s

  clocks:
    maxItems: 1
    description:
      AP NCO channel supplying the bitclock (T7001, T8010). On T7001 the
      MCA divides it by two.

  clock-names:
    const: bitclk

  reg:
    items:
      - description: MCA registers
      - description: MCLK control word

  reg-names:
    items:
      - const: mca
      - const: mclk

  interrupts:
    maxItems: 1

  power-domains:
    maxItems: 1

  dmas:
    minItems: 1
    items:
      - description: SmartIO transmit (playback) endpoint
      - description: SmartIO receive (capture) endpoint

  dma-names:
    minItems: 1
    items:
      - const: tx
      - const: rx

  '#sound-dai-cells':
    const: 0

  port:
    $ref: audio-graph-port.yaml#
    unevaluatedProperties: false
    description:
      The link to the codecs when an audio-graph-card2 card uses this MCA.

  '#clock-cells':
    const: 0

  clock-output-names:
    maxItems: 1

  apple,i2s-switch:
    $ref: /schemas/types.yaml#/definitions/phandle-array
    items:
      - items:
          - description: phandle of the i2s-switch syscon
          - description: index of this MCA's node in the switch (audN)
            maximum: 4
          - description: index of the pad the codec is wired to (pinN)
            maximum: 4
    description:
      The i2s-switch route between this MCA and the pad its codec is
      connected to. The route is programmed while a stream is prepared.

  apple,aop-i2s-route:
    $ref: /schemas/types.yaml#/definitions/phandle-array
    maxItems: 4
    items:
      - items:
          - description: phandle of an AOP i2s-switch syscon
          - description: register offset
          - description: value
    description:
      Writes that pass this MCA's link on through the AOP's i2s-switch, for
      a codec wired to AOP pads. They are written when a stream starts and
      left in place.

required:
  - compatible
  - reg
  - reg-names
  - interrupts
  - power-domains
  - dmas
  - dma-names
  - '#sound-dai-cells'
  - '#clock-cells'

unevaluatedProperties: false

examples:
  - |
    #include <dt-bindings/interrupt-controller/apple-aic.h>
    #include <dt-bindings/interrupt-controller/irq.h>

    soc {
      #address-cells = <2>;
      #size-cells = <2>;

      i2s_switch: syscon@20a003000 {
        compatible = "apple,s8000-i2s-switch", "syscon";
        reg = <0x2 0x0a003000 0x0 0x1000>;
      };

      mca@20a0a0000 {
        compatible = "apple,s8000-mca";
        reg = <0x2 0x0a0a0000 0x0 0x4000>,
              <0x2 0x0a002000 0x0 0x4>;
        reg-names = "mca", "mclk";
        interrupt-parent = <&aic>;
        interrupts = <AIC_IRQ 201 IRQ_TYPE_LEVEL_HIGH>;
        power-domains = <&ps_mca0>;
        dmas = <&sio 0x28>, <&sio 0x29>;
        dma-names = "tx", "rx";
        apple,i2s-switch = <&i2s_switch 0 0>;
        #clock-cells = <0>;
        clock-output-names = "mca0-mclk";
        #sound-dai-cells = <0>;
      };
    };
```

## Documentation/devicetree/bindings/sound/apple,t8010-pdm.yaml
```yaml
# SPDX-License-Identifier: (GPL-2.0-only OR BSD-2-Clause)
%YAML 1.2
---
$id: http://devicetree.org/schemas/sound/apple,t8010-pdm.yaml#
$schema: http://devicetree.org/meta-schemas/core.yaml#

title: Apple T8010 and T8011 PDM microphone controller

maintainers:
  - Henrik Klee <henrik@goat-code.com>

description:
  The PDM microphone controller of the Apple A10 records the built-in
  PDM microphones. T8011 uses a different SmartIO FIFO and trigger pair.
  Each microphone has a HiFi decimator that filters its
  bit stream down to PCM; the controller hands the samples to SmartIO
  DMA. The PDM clock comes from the Always-On Processor's audio service.

allOf:
  - $ref: dai-common.yaml#

properties:
  compatible:
    enum:
      - apple,t8010-pdm
      - apple,t8011-pdm

  reg:
    minItems: 2
    items:
      - description: Controller registers
      - description: Decimator of the first microphone
      - description: Decimator of the second microphone

  reg-names:
    minItems: 2
    items:
      - const: pdm
      - const: dec0
      - const: dec1

  interrupts:
    maxItems: 1

  clocks:
    items:
      - description: PDM microphone clock

  power-domains:
    maxItems: 1

  dmas:
    maxItems: 1

  dma-names:
    const: rx

  "#sound-dai-cells":
    const: 0

required:
  - compatible
  - reg
  - reg-names
  - interrupts
  - clocks
  - power-domains
  - dmas
  - dma-names
  - "#sound-dai-cells"

unevaluatedProperties: false

examples:
  - |
    #include <dt-bindings/interrupt-controller/apple-aic.h>
    #include <dt-bindings/interrupt-controller/irq.h>

    soc {
        #address-cells = <2>;
        #size-cells = <2>;

        pdm@20a0b4000 {
            compatible = "apple,t8010-pdm";
            reg = <0x2 0x0a0b4000 0x0 0x1000>,
                  <0x2 0x0a120000 0x0 0x4000>,
                  <0x2 0x0a124000 0x0 0x4000>;
            reg-names = "pdm", "dec0", "dec1";
            interrupt-parent = <&aic>;
            interrupts = <AIC_IRQ 238 IRQ_TYPE_LEVEL_HIGH>;
            clocks = <&aop_audio>;
            power-domains = <&ps_hfd0>;
            dmas = <&sio 0x5b>;
            dma-names = "rx";
            #sound-dai-cells = <0>;
        };
    };
```

## Documentation/devicetree/bindings/sound/cirrus,cs35l19.yaml
```yaml
# SPDX-License-Identifier: (GPL-2.0-only OR BSD-2-Clause)
%YAML 1.2
---
$id: http://devicetree.org/schemas/sound/cirrus,cs35l19.yaml#
$schema: http://devicetree.org/meta-schemas/core.yaml#

title: Cirrus Logic CS35L19 speaker amplifier

maintainers:
  - ricktav <82380971+ricktav@users.noreply.github.com>

description: |
  Boosted class-D speaker amplifier with a TDM serial port, a relative of
  the CS35L33 with Apple's power-on sequence. The CS35L21 is driven the
  same way. Apple's iPad minis use two on one I2C bus, sharing one reset
  line and one TDM link; the iPhone 6s and 6s Plus use one for the
  loudspeaker. Each amplifier is one node and reads the slot its graph
  endpoint gives it. An amplifier whose endpoint is the bit and frame
  clock provider drives the frame, from the MCLK it is given.

allOf:
  - $ref: dai-common.yaml#

properties:
  compatible:
    const: cirrus,cs35l19

  reg:
    maxItems: 1

  reset-gpios:
    maxItems: 1
    description:
      Shared by the amplifiers of one board, so each of them names it.

  cirrus,keepalive-gpios:
    maxItems: 1
    description:
      Input of the amplifier's alive watchdog. Toggled while the amplifier
      plays; without it, the watchdog is turned off.

  clocks:
    maxItems: 1

  clock-names:
    const: mclk

  apple,speaker-config:
    $ref: /schemas/types.yaml#/definitions/uint8-array
    minItems: 20
    maxItems: 20
    description:
      The "speaker-config" record of the amplifier in Apple's device tree.

  '#sound-dai-cells':
    const: 0

  port:
    $ref: audio-graph-port.yaml#
    unevaluatedProperties: false

required:
  - compatible
  - reg
  - clocks
  - clock-names
  - '#sound-dai-cells'

unevaluatedProperties: false

examples:
  - |
    #include <dt-bindings/gpio/gpio.h>

    i2c {
        #address-cells = <1>;
        #size-cells = <0>;

        amplifier@40 {
            compatible = "cirrus,cs35l19";
            reg = <0x40>;
            reset-gpios = <&pinctrl 114 GPIO_ACTIVE_LOW>;
            clocks = <&mca1>;
            clock-names = "mclk";
            apple,speaker-config = /bits/ 8 <
                0x49 0x30 0x02 0x70 0x6a 0x80 0x30 0x1e 0x02 0x04
                0x14 0x89 0x8a 0x10 0x74 0x03 0x05 0x00 0x00 0x40>;
            #sound-dai-cells = <0>;
            sound-name-prefix = "Left";
        };
    };
```

## Documentation/devicetree/bindings/sound/cirrus,cs42l71.yaml
```yaml
# SPDX-License-Identifier: (GPL-2.0-only OR BSD-2-Clause)
%YAML 1.2
---
$id: http://devicetree.org/schemas/sound/cirrus,cs42l71.yaml#
$schema: http://devicetree.org/meta-schemas/core.yaml#

title: Cirrus Logic CS42L71 audio codec

maintainers:
  - ricktav <82380971+ricktav@users.noreply.github.com>

description: |
  Apple-specific Cirrus Logic headset codec used on the iPhone 6s and 6s
  Plus. It is controlled over SPI with Apple's SPIv2 framed protocol
  (24-bit little-endian register addresses). Headset PCM is the main
  port (XSP) on pad 0 / MCA0. The codec's ASP on pad 2 is shared with
  the loudspeaker amplifier; Linux must not make that port a clock
  provider. MCLK, when present, is 12 MHz from MCA0.

allOf:
  - $ref: /schemas/spi/spi-peripheral-props.yaml#

properties:
  compatible:
    const: cirrus,cs42l71

  reg:
    maxItems: 1

  clocks:
    maxItems: 1

  clock-names:
    const: mclk

  interrupts:
    maxItems: 1
    description:
      Jack and headset events, level low.

  cirrus,ldo-pulldown-gpios:
    maxItems: 1
    description:
      The PMU line that pulls the codec's digital LDO down; driven low
      before the codec is used.

  '#sound-dai-cells':
    const: 0

required:
  - compatible
  - reg

unevaluatedProperties: false

examples:
  - |
    spi {
      #address-cells = <1>;
      #size-cells = <0>;

      audio-codec@0 {
        compatible = "cirrus,cs42l71";
        reg = <0>;
        spi-max-frequency = <1000000>;
      };
    };
```

## Documentation/devicetree/bindings/sound/maxim,max98925.yaml
```yaml
# SPDX-License-Identifier: GPL-2.0-only OR BSD-2-Clause
%YAML 1.2
---
$id: http://devicetree.org/schemas/sound/maxim,max98925.yaml#
$schema: http://devicetree.org/meta-schemas/core.yaml#

title: Maxim Integrated MAX98721/MAX98925/MAX98926/MAX98927 speaker amplifier

maintainers:
  - Ryan Lee <ryans.lee@maximintegrated.com>

description:
  The MAX98721 is a variant of the MAX98925 found in Apple devices. It runs
  as a TDM consumer and plays the first slot of its DAI link's
  dai-tdm-slot-rx-mask.

properties:
  compatible:
    enum:
      - maxim,max98721
      - maxim,max98925
      - maxim,max98926
      - maxim,max98927

  reg:
    maxItems: 1

  interrupts:
    maxItems: 1

  reset-gpios:
    maxItems: 1

  '#sound-dai-cells':
    const: 0

  port:
    $ref: audio-graph-port.yaml#
    unevaluatedProperties: false

  vmon-slot-no:
    $ref: /schemas/types.yaml#/definitions/uint32
    minimum: 0
    maximum: 30
    default: 0
    description:
      Slot number used to send voltage information or in inteleave mode this
      will be used as interleave slot.

  imon-slot-no:
    $ref: /schemas/types.yaml#/definitions/uint32
    minimum: 0
    maximum: 30
    default: 0
    description:
      Slot number used to send current information.

  maxim,interleave-mode:
    type: boolean
    description:
      When using two MAX9892X in a system it is possible to create ADC data
      that will overflow the frame size. When enabled, the Digital Audio
      Interleave mode provides a means to output VMON and IMON data from two
      devices on a single DOUT line when running smaller frames sizes such as
      32 BCLKS per LRCLK or 48 BCLKS per LRCLK.

required:
  - compatible
  - reg

allOf:
  - $ref: dai-common.yaml#
  - if:
      properties:
        compatible:
          contains:
            enum:
              - maxim,max98927
    then:
      properties:
        vmon-slot-no:
          minimum: 0
          maximum: 15

        imon-slot-no:
          minimum: 0
          maximum: 15

unevaluatedProperties: false

examples:
  - |
    #include <dt-bindings/gpio/gpio.h>
    i2c {
        #address-cells = <1>;
        #size-cells = <0>;

        audio-codec@3a {
            compatible = "maxim,max98927";
            reg = <0x3a>;
            #sound-dai-cells = <0>;

            pinctrl-0 = <&speaker_default>;
            pinctrl-names = "default";

            reset-gpios = <&tlmm 69 GPIO_ACTIVE_LOW>;

            vmon-slot-no = <1>;
            imon-slot-no = <0>;
        };
    };

  - |
    #include <dt-bindings/interrupt-controller/irq.h>
    i2c {
        #address-cells = <1>;
        #size-cells = <0>;

        amplifier@31 {
            compatible = "maxim,max98721";
            reg = <0x31>;
            interrupts-extended = <&pinctrl 8 IRQ_TYPE_LEVEL_LOW>;
            #sound-dai-cells = <0>;
            sound-name-prefix = "Amp0";

            port {
                endpoint {
                    remote-endpoint = <&speaker_amp0_ep>;
                    dai-tdm-slot-num = <8>;
                    dai-tdm-slot-width = <32>;
                    dai-tdm-slot-rx-mask = <1>;
                };
            };
        };
    };
```
