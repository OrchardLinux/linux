// SPDX-License-Identifier: GPL-2.0+ OR MIT
/*
 * Apple iPhone 8 common device tree
 *
 * Copyright (c) 2022, Konrad Dybcio <konradybcio@kernel.org>
 */

#include "t8015.dtsi"
#include "t8015-common.dtsi"

/ {
	chassis-type = "handset";
};

&dwi_bl {
	status = "okay";
};

/*
 * The AOP owns the interrupts of its own GPIOs: it arms the Touch ID
 * sensor's interrupt (AOP GPIO 21) once the AP hands the sensor over.
 * Nothing here takes an AOP GPIO interrupt, and if Linux claims the
 * group lines it sees that pin pending forever and CPU0 never leaves
 * the handler.
 */
&pinctrl_aop {
	/delete-property/ interrupt-controller;
	/delete-property/ #interrupt-cells;
	/delete-property/ interrupts;
};
