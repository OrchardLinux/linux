// SPDX-License-Identifier: GPL-2.0+ OR MIT
/*
 * Apple iPhone XS Max (China), D331 iPhone11,4
 * Copyright (c) 2026, Henrik Klee <henrik@goat-code.com>
 */

/dts-v1/;

#include "t8020.dtsi"
#include "t8020-common.dtsi"

/ {
	compatible = "apple,d331", "apple,t8020", "apple,arm-platform";
	model = "Apple iPhone XS Max (China)";
	chassis-type = "handset";
};
