// SPDX-License-Identifier: GPL-2.0+ OR MIT
/*
 * Apple iPhone 6 Plus, N56, iPhone7,2 (A1549/A1586/A1589)
 * Copyright (c) 2022, Konrad Dybcio <konradybcio@kernel.org>
 */

/dts-v1/;

#include "t7000-6.dtsi"

/ {
	compatible = "apple,n56", "apple,t7000", "apple,arm-platform";
	model = "Apple iPhone 6 Plus";
};

/*
 * The display pipe takes the 1080x1920 MIPI DSI panel over from simpledrm.
 * No panel supply is given: the panel stays on in system sleep.
 */
&disp0 {
	status = "okay";
};

/* BCM4345B0 Bluetooth core; the iPod touch 6 entry has its sequence. */
&bluetooth {
	compatible = "apple,n56-bcm4345b0-bt", "apple,n102-bcm4345b1-bt";
};

/* ADT uart4/wlan module-instance */
&wifi0 {
	brcm,board-type = "apple,barbera";
};
