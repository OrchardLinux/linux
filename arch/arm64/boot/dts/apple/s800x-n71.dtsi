// SPDX-License-Identifier: GPL-2.0+ OR MIT
/*
 * Apple iPhone 6s (N71, N71m): what the Samsung and TSMC models share
 */

#include "s800x-6s.dtsi"

/* ADT i2c2/als: als,ct821 */
&als {
	compatible = "apple,ct821", "amstaos,tsl2581";
};

/* ADT multi-touch,n71; AppleMultitouchN1SPI personality C1F5B */
&touchscreen {
	compatible = "apple,n71-touchscreen";
	firmware-name = "apple/n71-fwstart.z2fw";
	touchscreen-size-x = <750>;
	touchscreen-size-y = <1334>;
};
