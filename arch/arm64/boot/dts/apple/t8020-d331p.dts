// SPDX-License-Identifier: GPL-2.0+ OR MIT
/*
 * Apple iPhone XS Max, D331p iPhone11,6
 * Copyright (c) 2026, Henrik Klee <henrik@goat-code.com>
 */

/dts-v1/;

#include "t8020.dtsi"
#include "t8020-common.dtsi"

/ {
	compatible = "apple,d331p", "apple,t8020", "apple,arm-platform";
	model = "Apple iPhone XS Max";
	chassis-type = "handset";
};
