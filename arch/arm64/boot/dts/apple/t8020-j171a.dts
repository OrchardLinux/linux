// SPDX-License-Identifier: GPL-2.0+ OR MIT
/*
 * Apple iPad 8 (Wi-Fi), J171a iPad11,6
 * Copyright (c) 2026, Henrik Klee <henrik@goat-code.com>
 */

/dts-v1/;

#include "t8020.dtsi"
#include "t8020-common.dtsi"

/ {
	compatible = "apple,j171a", "apple,t8020", "apple,arm-platform";
	model = "Apple iPad 8 (Wi-Fi)";
	chassis-type = "tablet";
};
